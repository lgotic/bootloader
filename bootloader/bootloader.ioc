# file: bootloader.ioc
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Mcu.Family=STM32F4
Mcu.Name=STM32F429ZITx
Mcu.Package=LQFP144
NVIC.PriorityGroup=NVIC_PRIORITYGROUP_4
PA13.Mode=Serial_Wire
PA13.Signal=SYS_JTMS-SWDIO
PA14.Mode=Serial_Wire
PA14.Signal=SYS_JTCK-SWCLK
PH0/OSC_IN.Mode=HSE-External-Oscillator
PH0/OSC_IN.Signal=RCC_OSC_IN
PH1/OSC_OUT.Mode=HSE-External-Oscillator
PH1/OSC_OUT.Signal=RCC_OSC_OUT
ProjectManager.HeapSize=0x200
ProjectManager.StackSize=0x400
ProjectManager.TargetToolchain=STM32CubeIDE
RCC.AHBFreq_Value=16000000
RCC.APB1Freq_Value=16000000
RCC.APB2Freq_Value=16000000
RCC.CortexFreq_Value=16000000
RCC.HSE_VALUE=25000000
RCC.HSI_VALUE=16000000
RCC.LSE_VALUE=32768
RCC.SYSCLKFreq_VALUE=16000000
RCC.VCOOutputFreq_Value=192000000
board=custom

// file: Core/Src/main.c
/* USER CODE BEGIN Header */
/**
  ******************************************************************************
  * @file           : main.c
  * @brief          : Main program body
  ******************************************************************************
  * @attention
  *
  * Copyright (c) 2022 STMicroelectronics.
  * All rights reserved.
  *
  * This software is licensed under terms that can be found in the LICENSE file
  * in the root directory of this software component.
  * If no LICENSE file comes with this software, it is provided AS-IS.
  *
  ******************************************************************************
  */
/* USER CODE END Header */
#include "main.h"
#include "gpio.h"

/* USER CODE BEGIN Includes */
#define SP_RANGE 0x2FFF0000u
#define SRAM_BASE_ADDR 0x20030000u
#define IS_VALID_SP(address) (((*(volatile uint32_t*)address) & SP_RANGE) == SRAM_BASE_ADDR)

#define APPLICATION_ADDRESS     (uint32_t)0x08004000u
#define APPLICATION_SECTOR_ADDRESS 1u
#define APPLICATION_SECTOR_LENGTH 1u
#define SECOND_FIMRWARE_ADDRESS (uint32_t)0x08008000u
#define SECOND_FIRMWARE_SECTOR_END (uint32_t)0x0800c000u
typedef void (*pFunction)(void);
/* USER CODE END Includes */

/* USER CODE BEGIN PTD */
void jumpToProgramFunction () {
pFunction Jump_To_Application_Function;
uint32_t JumpAddress;
JumpAddress = *(volatile uint32_t*) (APPLICATION_ADDRESS + 4);
Jump_To_Application_Function = (void*) JumpAddress;
__set_MSP(*(__IO uint32_t*) APPLICATION_ADDRESS);
Jump_To_Application_Function();
}
/* USER CODE END PTD */

void SystemClock_Config(void);

/* USER CODE BEGIN 0 */

void cleareSector () {
	FLASH_EraseInitTypeDef EraseInitStruct;
	volatile uint8_t flashEraseError;
	uint32_t volatile sectorError;

	EraseInitStruct.TypeErase = FLASH_TYPEERASE_SECTORS;
	EraseInitStruct.Sector = APPLICATION_SECTOR_ADDRESS;
	EraseInitStruct.NbSectors = APPLICATION_SECTOR_LENGTH;
	EraseInitStruct.VoltageRange = FLASH_VOLTAGE_RANGE_3;

	if ( HAL_FLASHEx_Erase(&EraseInitStruct, &sectorError) != HAL_OK) {
		  flashEraseError=HAL_FLASH_GetError();
	  }

}

void flashNewFirmware () {
	HAL_StatusTypeDef flag;
	flag = HAL_FLASH_Unlock();
	volatile uint32_t flashData = 0;
	uint32_t firmwareAddress = APPLICATION_ADDRESS;
	__HAL_FLASH_CLEAR_FLAG(FLASH_FLAG_EOP | FLASH_FLAG_WRPERR | FLASH_FLAG_BSY);
	cleareSector ();

	for (int positionCounter = SECOND_FIMRWARE_ADDRESS ; positionCounter < SECOND_FIRMWARE_SECTOR_END; positionCounter = positionCounter+4) {
		flashData = (*(uint8_t *)(positionCounter + 3)) << 24;
		flashData = flashData | (*(uint8_t *)(positionCounter + 2)) << 16;
		flashData = flashData | (*(uint8_t *)(positionCounter + 1)) << 8;
		flashData = flashData | (*(uint8_t *)(positionCounter));

		HAL_FLASH_Program(FLASH_TYPEPROGRAM_WORD, firmwareAddress, flashData);
		for ( int I = 0 ; I <200 ; I ++) {};
		while (__HAL_FLASH_GET_FLAG(FLASH_FLAG_BSY) != RESET) {};
		firmwareAddress = firmwareAddress+4;
		}
	HAL_FLASH_Lock();
	}

/* USER CODE END 0 */

int main(void)
{
  /* USER CODE BEGIN 1 */
	//__disable_irq();
  /* USER CODE END 1 */

  /* MCU Configuration--------------------------------------------------------*/

  /* Reset of all peripherals, Initializes the Flash interface and the Systick. */
  HAL_Init();

  /* Configure the system clock */
  SystemClock_Config();

  /* Initialize all configured peripherals */
  MX_GPIO_Init();

  /* Infinite loop */
  while (1)
  {
	  if ( *(uint8_t*)(0x08003000) == 0x00) {
		  flashNewFirmware ();
	  }
	  else if ( IS_VALID_SP(APPLICATION_ADDRESS)) {

		  HAL_Delay(1000);
		  //__disable_irq();
		  HAL_SuspendTick();
		  HAL_DeInit();
		  __enable_irq();
		  jumpToProgramFunction ();
	  }
	  else {

		  flashNewFirmware ();
	  }
  }
}

void SystemClock_Config(void)
{
  RCC_OscInitTypeDef RCC_OscInitStruct = {0};
  RCC_ClkInitTypeDef RCC_ClkInitStruct = {0};

  /** Configure the main internal regulator output voltage
  */
  __HAL_RCC_PWR_CLK_ENABLE();
  __HAL_PWR_VOLTAGESCALING_CONFIG(PWR_REGULATOR_VOLTAGE_SCALE3);

  /** Initializes the RCC Oscillators according to the specified parameters
  * in the RCC_OscInitTypeDef structure.
  */
  RCC_OscInitStruct.OscillatorType = RCC_OSCILLATORTYPE_HSI;
  RCC_OscInitStruct.HSIState = RCC_HSI_ON;
  RCC_OscInitStruct.HSICalibrationValue = RCC_HSICALIBRATION_DEFAULT;
  RCC_OscInitStruct.PLL.PLLState = RCC_PLL_NONE;
  if (HAL_RCC_OscConfig(&RCC_OscInitStruct) != HAL_OK)
  {
    Error_Handler();
  }

  /** Initializes the CPU, AHB and APB buses clocks
  */
  RCC_ClkInitStruct.ClockType = RCC_CLOCKTYPE_HCLK|RCC_CLOCKTYPE_SYSCLK
                              |RCC_CLOCKTYPE_PCLK1|RCC_CLOCKTYPE_PCLK2;
  RCC_ClkInitStruct.SYSCLKSource = RCC_SYSCLKSOURCE_HSI;
  RCC_ClkInitStruct.AHBCLKDivider = RCC_SYSCLK_DIV1;
  RCC_ClkInitStruct.APB1CLKDivider = RCC_HCLK_DIV1;
  RCC_ClkInitStruct.APB2CLKDivider = RCC_HCLK_DIV1;

  if (HAL_RCC_ClockConfig(&RCC_ClkInitStruct, FLASH_LATENCY_0) != HAL_OK)
  {
    Error_Handler();
  }
}

void Error_Handler(void)
{
  __disable_irq();
  while (1)
  {
  }
}
